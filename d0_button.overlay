 #include <zephyr/dt-bindings/input/input-event-codes.h>

 / {
     buttons {
         compatible = "gpio-keys";
         xiao_button1: button_1 {
             gpios = <&xiao_d 0 (GPIO_PULL_UP | GPIO_ACTIVE_LOW)>;
             label = "SW1";
             zephyr,code = <INPUT_KEY_1>;
         };
     };

     aliases {
         sw1 = &xiao_button1;
     };
 };
